/dts-v1/;

/ {

	fragment@0 {
		target = <0xffffffff>;

		__overlay__ {
			#address-cells = <0x02>;
			#size-cells = <0x02>;
			ranges;

			zmc-default {
				compatible = "mediatek,zone_movable_cma";
				size = <0x00 0xffc00000>;
				alignment = <0x00 0x10000000>;
				alloc-ranges = <0x00 0xc0000000 0x01 0x00>;
			};
		};
	};

	fragment@1 {
		target = <0xffffffff>;

		__overlay__ {
			atag,videolfb-fb_base_h = <0x00>;
			atag,videolfb-fb_base_l = "^`P";
			atag,videolfb-islcmfound = <0x01>;
			atag,videolfb-islcm_inited = <0x00>;
			atag,videolfb-fps = <0x1770>;
			atag,videolfb-vramSize = <0x17bb000>;
			atag,videolfb-lcmname = "nt35695B_fhd_dsi_cmd_auo_rt5081_drv";
		};
	};

	fragment@2 {
		target = <0xffffffff>;

		__overlay__ {

			led@0 {
				compatible = "mediatek,red";
				led_mode = <0x00>;
				data = <0x01>;
				pwm_config = <0x00 0x00 0x00 0x00 0x00>;
				linux,phandle = <0x38>;
				phandle = <0x38>;
			};

			led@1 {
				compatible = "mediatek,green";
				led_mode = <0x00>;
				data = <0x01>;
				pwm_config = <0x00 0x00 0x00 0x00 0x00>;
				linux,phandle = <0x39>;
				phandle = <0x39>;
			};

			led@2 {
				compatible = "mediatek,blue";
				led_mode = <0x00>;
				data = <0x01>;
				pwm_config = <0x00 0x00 0x00 0x00 0x00>;
				linux,phandle = <0x3a>;
				phandle = <0x3a>;
			};

			led@3 {
				compatible = "mediatek,jogball-backlight";
				led_mode = <0x00>;
				data = <0x01>;
				pwm_config = <0x00 0x00 0x00 0x00 0x00>;
				linux,phandle = <0x3b>;
				phandle = <0x3b>;
			};

			led@4 {
				compatible = "mediatek,keyboard-backlight";
				led_mode = <0x00>;
				data = <0x01>;
				pwm_config = <0x00 0x00 0x00 0x00 0x00>;
				linux,phandle = <0x3c>;
				phandle = <0x3c>;
			};

			led@5 {
				compatible = "mediatek,button-backlight";
				led_mode = <0x00>;
				data = <0x01>;
				pwm_config = <0x00 0x00 0x00 0x00 0x00>;
				linux,phandle = <0x3d>;
				phandle = <0x3d>;
			};

			led@6 {
				compatible = "mediatek,lcd-backlight";
				led_mode = <0x05>;
				data = <0x01>;
				pwm_config = <0x00 0x03 0x00 0x00 0x00>;
				linux,phandle = <0x3e>;
				phandle = <0x3e>;
			};

			vibrator@0 {
				compatible = "mediatek,vibrator";
				vib_timer = <0x19>;
				vib_limit = <0x09>;
				vib_vol = <0x09>;
				linux,phandle = <0x3f>;
				phandle = <0x3f>;
			};
		};
	};

	fragment@3 {
		target = <0xffffffff>;

		__overlay__ {

			cap_touch@26 {
				compatible = "mstar,msg5846";
				reg = <0x26>;
			};

			cap_touch@10 {
				compatible = "synaptics,td4100";
				reg = <0x20>;
				status = "okay";
			};

			cap_touch@2e {
				compatible = "mediatek,tlsc6x_touch";
				reg = <0x2e>;
				status = "okay";
			};

			cap_touch@38 {
				compatible = "focaltech,ft3327";
				reg = <0x38>;
				status = "disable";
			};

			cap_touch@48 {
				compatible = "chipone,icn8xx";
				reg = <0x48>;
			};
		};
	};

	fragment@4 {
		target = <0xffffffff>;

		__overlay__ {

			gyro@68 {
				i2c_num = <0x01>;
				i2c_addr = <0x68 0x00 0x00 0x00>;
				direction = <0x04>;
				power_id = <0xffff>;
				power_vol = <0x00>;
				firlen = <0x00>;
				is_batch_supported = <0x00>;
			};

			alsps@67 {
				compatible = "mediatek,alsps";
				pinctrl-names = "pin_default\0pin_cfg";
				pinctrl-0 = <0x01>;
				pinctrl-1 = <0x02>;
				status = "okay";
				i2c_num = <0x01>;
				i2c_addr = <0x67 0x00 0x00 0x00>;
				polling_mode_ps = <0x00>;
				polling_mode_als = <0x01>;
				power_id = <0xffff>;
				power_vol = <0x00>;
				als_level = <0x0a 0x32 0x64 0xc8 0x190 0x2bc 0x3e8 0x5dc 0x898 0xbb8 0xdac 0xfa0 0x1194 0x1388 0x157c>;
				als_value = <0x00 0x32 0x64 0xc8 0x15e 0x258 0x44c 0x5dc 0x898 0xbb8 0xfa0 0x1770 0x1f40 0x2710 0x4e20 0x4e20>;
				ps_threshold_high = <0xfa>;
				ps_threshold_low = <0x64>;
				is_batch_supported_ps = <0x00>;
				is_batch_supported_als = <0x00>;
			};

			barometer@77 {
				i2c_num = <0x01>;
				i2c_addr = <0x77 0x00 0x00 0x00>;
				direction = <0x00>;
				power_id = <0xffff>;
				power_vol = <0x00>;
				firlen = <0x20>;
				is_batch_supported = <0x00>;
			};
		};
	};

	fragment@5 {
		target = <0xffffffff>;

		__overlay__ {
			status = "okay";
		};
	};

	fragment@6 {
		target = <0xffffffff>;

		__overlay__ {
			#address-cells = <0x01>;
			#size-cells = <0x00>;
			clock-frequency = <0x61a80>;

			mtk-usb@60 {
				compatible = "mediatek,mtk-usb";
				reg = <0x60>;
				status = "okay";
			};
		};
	};

	fragment@7 {
		target = <0xffffffff>;

		__overlay__ {
			tpd-resolution = <0x2d0 0x5f0>;
			use-tpd-button = <0x00>;
			tpd-key-num = <0x03>;
			tpd-key-local = <0x8b 0xac 0x9e 0x00>;
			tpd-key-dim-local = <0x5a 0x373 0x64 0x28 0xe6 0x373 0x64 0x28 0x172 0x373 0x64 0x28 0x00 0x00 0x00 0x00>;
			tpd-max-touch-num = <0x05>;
			tpd-filter-enable = <0x00>;
			tpd-filter-pixel-density = <0x6a>;
			tpd-filter-custom-prameters = <0x00 0x00 0x00 0x00 0x00 0x00 0x00 0x00 0x00 0x00 0x00 0x00>;
			tpd-filter-custom-speed = <0x00 0x00 0x00>;
			pinctrl-names = "default\0state_eint_as_int\0state_eint_output0\0state_eint_output1\0state_rst_output0\0state_rst_output1";
			pinctrl-0 = <0x03>;
			pinctrl-1 = <0x04>;
			pinctrl-2 = <0x05>;
			pinctrl-3 = <0x06>;
			pinctrl-4 = <0x07>;
			pinctrl-5 = <0x08>;
			status = "okay";
		};
	};

	fragment@8 {
		target = <0xffffffff>;

		__overlay__ {

			eint0default {
				linux,phandle = <0x03>;
				phandle = <0x03>;
			};

			eint@0 {
				linux,phandle = <0x04>;
				phandle = <0x04>;

				pins_cmd_dat {
					pinmux = <0x100>;
					slew-rate = <0x00>;
					bias-disable;
				};
			};

			eintoutput0 {
				linux,phandle = <0x05>;
				phandle = <0x05>;

				pins_cmd_dat {
					pinmux = <0x100>;
					slew-rate = <0x01>;
					output-low;
				};
			};

			eintoutput1 {
				linux,phandle = <0x06>;
				phandle = <0x06>;

				pins_cmd_dat {
					pinmux = <0x100>;
					slew-rate = <0x01>;
					output-high;
				};
			};

			rstoutput0 {
				linux,phandle = <0x07>;
				phandle = <0x07>;

				pins_cmd_dat {
					pinmux = <0xf00>;
					slew-rate = <0x01>;
					output-low;
				};
			};

			rstoutput1 {
				linux,phandle = <0x08>;
				phandle = <0x08>;

				pins_cmd_dat {
					pinmux = <0xf00>;
					slew-rate = <0x01>;
					output-high;
				};
			};
		};
	};

	fragment@9 {
		target = <0xffffffff>;

		__overlay__ {
			i2c_num = <0x01>;
			direction = <0x03>;
			power_id = <0xffff>;
			power_vol = <0x00>;
			firlen = <0x10>;
			is_batch_supported = <0x01>;
		};
	};

	fragment@10 {
		target = <0xffffffff>;

		__overlay__ {
			i2c_num = <0x01>;
			i2c_addr = <0x0c 0x00 0x00 0x00>;
			direction = <0x03>;
			power_id = <0xffff>;
			power_vol = <0x00>;
			is_batch_supported = <0x00>;
		};
	};

	fragment@11 {
		target = <0xffffffff>;

		__overlay__ {

			alspspincfg {
				linux,phandle = <0x02>;
				phandle = <0x02>;

				pins_cmd_dat {
					pinmux = <0x600>;
					slew-rate = <0x00>;
					bias-pull-up = <0x00>;
				};
			};

			alspsdefaultcfg {
				linux,phandle = <0x01>;
				phandle = <0x01>;
			};
		};
	};

	fragment@12 {
		target = <0xffffffff>;

		__overlay__ {
			accdet-mic-vol = <0x06>;
			headset-mode-setting = <0x500 0x500 0x01 0x1f0 0x800 0x800 0x20 0x44>;
			accdet-plugout-debounce = <0x01>;
			accdet-mic-mode = <0x01>;
			headset-eint-level-pol = <0x08>;
			headset-three-key-threshold = <0x00 0x50 0xc8 0x190>;
			headset-three-key-threshold-CDD = <0x00 0x79 0xc0 0x258>;
			headset-four-key-threshold = <0x00 0x3a 0x79 0xc0 0x190>;
			pinctrl-names = "default\0state_eint_as_int";
			pinctrl-0 = <0x09>;
			pinctrl-1 = <0x0a>;
			status = "okay";
		};
	};

	fragment@13 {
		target = <0xffffffff>;

		__overlay__ {

			accdetdefault {
				linux,phandle = <0x09>;
				phandle = <0x09>;
			};

			accdeteint@0 {
				linux,phandle = <0x0a>;
				phandle = <0x0a>;

				pins_cmd_dat {
					pinmux = <0x900>;
					slew-rate = <0x00>;
					bias-disable;
				};
			};
		};
	};

	fragment@14 {
		target = <0xffffffff>;

		__overlay__ {

			consys_default {
				linux,phandle = <0x0b>;
				phandle = <0x0b>;
			};

			gpslna@0 {
				linux,phandle = <0x0c>;
				phandle = <0x0c>;

				pins_cmd_dat {
					pinmux = <0x6b00>;
					slew-rate = <0x00>;
					bias-disable;
					output-low;
				};
			};

			gpslna@1 {
				linux,phandle = <0x0d>;
				phandle = <0x0d>;

				pins_cmd_dat {
					pinmux = <0x6b00>;
					slew-rate = <0x01>;
					output-high;
				};
			};

			gpslna@2 {
				linux,phandle = <0x0e>;
				phandle = <0x0e>;

				pins_cmd_dat {
					pinmux = <0x6b00>;
					slew-rate = <0x01>;
					output-low;
				};
			};
		};
	};

	fragment@15 {
		target = <0xffffffff>;

		__overlay__ {
			pinctrl-names = "default\0gps_lna_state_init\0gps_lna_state_oh\0gps_lna_state_ol";
			pinctrl-0 = <0x0b>;
			pinctrl-1 = <0x0c>;
			pinctrl-2 = <0x0d>;
			pinctrl-3 = <0x0e>;
			status = "okay";
		};
	};

	fragment@16 {
		target = <0xffffffff>;

		__overlay__ {

			cam0@0 {
				linux,phandle = <0x10>;
				phandle = <0x10>;

				pins_cmd_dat {
					pinmux = <0x6500>;
					slew-rate = <0x01>;
					output-low;
				};
			};

			cam0@1 {
				linux,phandle = <0x11>;
				phandle = <0x11>;

				pins_cmd_dat {
					pinmux = <0x6500>;
					slew-rate = <0x01>;
					output-high;
				};
			};

			cam0@2 {
				linux,phandle = <0x12>;
				phandle = <0x12>;

				pins_cmd_dat {
					pinmux = <0x6100>;
					slew-rate = <0x01>;
					output-low;
				};
			};

			cam0@3 {
				linux,phandle = <0x13>;
				phandle = <0x13>;

				pins_cmd_dat {
					pinmux = <0x6100>;
					slew-rate = <0x01>;
					output-high;
				};
			};

			cam1@0 {
				linux,phandle = <0x14>;
				phandle = <0x14>;

				pins_cmd_dat {
					pinmux = <0x6600>;
					slew-rate = <0x01>;
					output-low;
				};
			};

			cam1@1 {
				linux,phandle = <0x15>;
				phandle = <0x15>;

				pins_cmd_dat {
					pinmux = <0x6600>;
					slew-rate = <0x01>;
					output-high;
				};
			};

			cam1@2 {
				linux,phandle = <0x16>;
				phandle = <0x16>;

				pins_cmd_dat {
					pinmux = <0x6200>;
					slew-rate = <0x01>;
					output-low;
				};
			};

			cam1@3 {
				linux,phandle = <0x17>;
				phandle = <0x17>;

				pins_cmd_dat {
					pinmux = <0x6200>;
					slew-rate = <0x01>;
					output-high;
				};
			};

			camera_pins_cam0_mclk_on {
				linux,phandle = <0x18>;
				phandle = <0x18>;

				pins_cmd_dat {
					pinmux = <0x6301>;
				};
			};

			camera_pins_cam0_mclk_off {
				linux,phandle = <0x19>;
				phandle = <0x19>;

				pins_cmd_dat {
					pinmux = <0x6300>;
				};
			};

			camera_pins_cam1_mclk_on {
				linux,phandle = <0x1a>;
				phandle = <0x1a>;

				pins_cmd_dat {
					pinmux = <0x6401>;
				};
			};

			camera_pins_cam1_mclk_off {
				linux,phandle = <0x1b>;
				phandle = <0x1b>;

				pins_cmd_dat {
					pinmux = <0x6400>;
				};
			};

			camdefault {
				linux,phandle = <0x0f>;
				phandle = <0x0f>;
			};
		};
	};

	fragment@17 {
		target = <0xffffffff>;

		__overlay__ {
			pinctrl-names = "default\0cam0_rst0\0cam0_rst1\0cam0_pnd0\0cam0_pnd1\0cam1_rst0\0cam1_rst1\0cam1_pnd0\0cam1_pnd1\0cam0_mclk_on\0cam0_mclk_off\0cam1_mclk_on\0cam1_mclk_off";
			pinctrl-0 = <0x0f>;
			pinctrl-1 = <0x10>;
			pinctrl-2 = <0x11>;
			pinctrl-3 = <0x12>;
			pinctrl-4 = <0x13>;
			pinctrl-5 = <0x14>;
			pinctrl-6 = <0x15>;
			pinctrl-7 = <0x16>;
			pinctrl-8 = <0x17>;
			pinctrl-13 = <0x18>;
			pinctrl-14 = <0x19>;
			pinctrl-15 = <0x1a>;
			pinctrl-16 = <0x1b>;
			status = "okay";
		};
	};

	fragment@18 {
		target = <0xffffffff>;

		__overlay__ {
			#address-cells = <0x01>;
			#size-cells = <0x00>;

			fingerprint@spi0 {
				compatible = "prize,fingerprint";
				reg = <0x00>;
				spi-max-frequency = <0xf4240>;
				fingerprint,touch-int-gpio = <0xffffffff 0x08 0x00>;
				status = "okay";
				linux,phandle = <0x40>;
				phandle = <0x40>;
			};
		};
	};

	fragment@19 {
		target = <0xffffffff>;

		__overlay__ {
			interrupt-parent = <0xffffffff>;
			interrupts = <0x08 0x02 0x08 0x00>;
			pinctrl-names = "default\0fpc_eint_as_int\0fpc_pins_rst_high\0fpc_pins_rst_low\0fpc_pins_pwr_high\0fpc_pins_pwr_low\0fpc_mode_as_cs\0fpc_mode_as_ck\0fpc_mode_as_mi\0fpc_mode_as_mo\0fpc_miso_pull_up\0fpc_miso_pull_down\0fpc_mosi_pull_up\0fpc_mosi_pull_down";
			pinctrl-0 = <0x1c>;
			pinctrl-1 = <0x1d>;
			pinctrl-2 = <0x1e>;
			pinctrl-3 = <0x1f>;
			pinctrl-4 = <0x20>;
			pinctrl-5 = <0x21>;
			pinctrl-6 = <0x22>;
			pinctrl-7 = <0x23>;
			pinctrl-8 = <0x24>;
			pinctrl-9 = <0x25>;
			pinctrl-10 = <0x26>;
			pinctrl-11 = <0x27>;
			pinctrl-12 = <0x28>;
			pinctrl-13 = <0x29>;
			status = "okay";
		};
	};

	fragment@20 {
		target = <0xffffffff>;

		__overlay__ {

			fpcdefault {
				linux,phandle = <0x1c>;
				phandle = <0x1c>;
			};

			fpceint@0 {
				linux,phandle = <0x1d>;
				phandle = <0x1d>;

				pins_cmd_dat {
					pinmux = <0x800>;
					slew-rate = <0x00>;
					bias-disable;
				};
			};

			fpcrsthigh {
				linux,phandle = <0x1e>;
				phandle = <0x1e>;

				pins_cmd_dat {
					pinmux = <0x1200>;
					slew-rate = <0x01>;
					output-high;
				};
			};

			fpcrstlow {
				linux,phandle = <0x1f>;
				phandle = <0x1f>;

				pins_cmd_dat {
					pinmux = <0x1200>;
					slew-rate = <0x01>;
					output-low;
				};
			};

			fpcpwrhigh {
				linux,phandle = <0x20>;
				phandle = <0x20>;

				pins_cmd_dat {
					pinmux = <0x5000>;
					slew-rate = <0x01>;
					output-high;
				};
			};

			fpcpwrlow {
				linux,phandle = <0x21>;
				phandle = <0x21>;

				pins_cmd_dat {
					pinmux = <0x5000>;
					slew-rate = <0x01>;
					output-low;
				};
			};

			fpccs {
				linux,phandle = <0x22>;
				phandle = <0x22>;

				pins_cmd_dat {
					pinmux = <0x5601>;
					bias-pull-up = <0x00>;
				};
			};

			fpcck {
				linux,phandle = <0x23>;
				phandle = <0x23>;

				pins_cmd_dat {
					pinmux = <0x5801>;
					bias-pull-up = <0x00>;
				};
			};

			fpcmi {
				linux,phandle = <0x24>;
				phandle = <0x24>;

				pins_cmd_dat {
					pinmux = <0x5501>;
					bias-pull-up = <0x00>;
				};
			};

			fpcmo {
				linux,phandle = <0x25>;
				phandle = <0x25>;

				pins_cmd_dat {
					pinmux = <0x5701>;
					bias-pull-down = <0x00>;
				};
			};

			fpcmisoup {
				linux,phandle = <0x26>;
				phandle = <0x26>;

				pins_cmd_dat {
					pinmux = <0x5500>;
					slew-rate = <0x01>;
					output-high;
				};
			};

			fpcmisolow {
				linux,phandle = <0x27>;
				phandle = <0x27>;

				pins_cmd_dat {
					pinmux = <0x5500>;
					slew-rate = <0x01>;
					output-low;
				};
			};

			fpcmosiup {
				linux,phandle = <0x28>;
				phandle = <0x28>;

				pins_cmd_dat {
					pinmux = <0x5700>;
					slew-rate = <0x01>;
					output-high;
				};
			};

			fpcmosilow {
				linux,phandle = <0x29>;
				phandle = <0x29>;

				pins_cmd_dat {
					pinmux = <0x5700>;
					slew-rate = <0x01>;
					output-low;
				};
			};
		};
	};

	fragment@21 {
		target = <0xffffffff>;

		__overlay__ {
			pinctrl-names = "uart0_gpio_default\0uart0_rx_set\0uart0_rx_clear\0uart0_tx_set\0uart0_tx_clear";
			pinctrl-0 = <0x2a>;
			pinctrl-1 = <0x2b>;
			pinctrl-2 = <0x2c>;
			pinctrl-3 = <0x2d>;
			pinctrl-4 = <0x2e>;
			status = "okay";
		};
	};

	fragment@22 {
		target = <0xffffffff>;

		__overlay__ {
			pinctrl-names = "uart1_gpio_default";
			pinctrl-0 = <0x2f>;
			status = "okay";
		};
	};

	fragment@23 {
		target = <0xffffffff>;

		__overlay__ {

			uart0gpiodefault {
				linux,phandle = <0x2a>;
				phandle = <0x2a>;
			};

			uart0_rx_set@gpio95 {
				linux,phandle = <0x2b>;
				phandle = <0x2b>;

				pins_cmd_dat {
					pinmux = <0x5f01>;
				};
			};

			uart0_rx_clear@gpio95 {
				linux,phandle = <0x2c>;
				phandle = <0x2c>;

				pins_cmd_dat {
					pinmux = <0x5f00>;
					slew-rate = <0x01>;
					output-high;
				};
			};

			uart0_tx_set@gpio96 {
				linux,phandle = <0x2d>;
				phandle = <0x2d>;

				pins_cmd_dat {
					pinmux = <0x6001>;
				};
			};

			uart0_tx_clear@gpio96 {
				linux,phandle = <0x2e>;
				phandle = <0x2e>;

				pins_cmd_dat {
					pinmux = <0x6000>;
					slew-rate = <0x01>;
					output-high;
				};
			};

			uart1gpiodefault {
				linux,phandle = <0x2f>;
				phandle = <0x2f>;
			};
		};
	};

	fragment@24 {
		target = <0xffffffff>;

		__overlay__ {
			pinctrl-names = "irtx_gpio_led_default\0irtx_gpio_led_set";
			pinctrl-0 = <0x30>;
			pinctrl-1 = <0x31>;
			status = "okay";
		};
	};

	fragment@25 {
		target = <0xffffffff>;

		__overlay__ {

			irtx_gpio_led_def@gpio58 {
				linux,phandle = <0x30>;
				phandle = <0x30>;

				pins_cmd_dat {
					pinmux = <0x3a00>;
					slew-rate = <0x01>;
					bias-disable;
					output-low;
					input-schmitt-enable = <0x00>;
				};
			};

			irtx_gpio_led_set@gpio58 {
				linux,phandle = <0x31>;
				phandle = <0x31>;

				pins_cmd_dat {
					pinmux = <0x3a03>;
					slew-rate = <0x01>;
					output-high;
				};
			};
		};
	};

	fragment@26 {
		target = <0xffffffff>;

		__overlay__ {
			pinctrl-names = "aud_dat_mosi_off\0aud_dat_mosi_on\0aud_dat_miso_off\0aud_dat_miso_on\0extamp-pullhigh\0extamp-pulllow";
			pinctrl-0 = <0x32>;
			pinctrl-1 = <0x33>;
			pinctrl-2 = <0x34>;
			pinctrl-3 = <0x35>;
			pinctrl-4 = <0x36>;
			pinctrl-5 = <0x37>;
			status = "okay";
		};
	};

	fragment@27 {
		target = <0xffffffff>;

		__overlay__ {

			aud_dat_mosi_off {
				linux,phandle = <0x32>;
				phandle = <0x32>;

				pins_cmd1_dat {
					pinmux = <0x8a00>;
					input-enable;
					slew-rate = <0x00>;
					bias-disable;
				};

				pins_cmd2_dat {
					pinmux = <0x8b00>;
					input-enable;
					slew-rate = <0x00>;
					bias-disable;
				};
			};

			aud_dat_mosi_on {
				linux,phandle = <0x33>;
				phandle = <0x33>;

				pins_cmd1_dat {
					pinmux = <0x8a01>;
				};

				pins_cmd2_dat {
					pinmux = <0x8b01>;
				};
			};

			aud_dat_miso_off {
				linux,phandle = <0x34>;
				phandle = <0x34>;

				pins_cmd1_dat {
					pinmux = <0x8e00>;
					input-enable;
					slew-rate = <0x00>;
					bias-disable;
				};

				pins_cmd2_dat {
					pinmux = <0x8f00>;
					input-enable;
					slew-rate = <0x00>;
					bias-disable;
				};
			};

			aud_dat_miso_on {
				linux,phandle = <0x35>;
				phandle = <0x35>;

				pins_cmd1_dat {
					pinmux = <0x8e01>;
				};

				pins_cmd2_dat {
					pinmux = <0x8f01>;
				};
			};

			aud_pins_extamp_pullhigh {
				linux,phandle = <0x36>;
				phandle = <0x36>;

				pins_cmd_dat {
					pinmux = <0x1300>;
					slew-rate = <0x01>;
					output-high;
				};
			};

			aud_pins_extamp_pulllow {
				linux,phandle = <0x37>;
				phandle = <0x37>;

				pins_cmd_dat {
					pinmux = <0x1300>;
					slew-rate = <0x01>;
					output-low;
				};
			};
		};
	};

	fragment@28 {
		target = <0xffffffff>;

		__overlay__ {
			mt6370,intr_gpio_num = <0x5b>;
			mt6370,intr_gpio = <0xffffffff 0x5b 0x00>;
		};
	};

	fragment@29 {
		target = <0xffffffff>;

		__overlay__ {
			mt6370pd,intr_gpio_num = <0x29>;
			mt6370pd,intr_gpio = <0xffffffff 0x29 0x00>;
		};
	};

	fragment@30 {
		target = <0xffffffff>;

		__overlay__ {
			gpio-rst = <0x19>;
			gpio-rst-std = <0xffffffff 0x19 0x00>;
			gpio-irq = <0x00>;
			gpio-irq-std = <0xffffffff 0x00 0x00>;
		};
	};

	fragment@31 {
		target = <0xffffffff>;

		__overlay__ {
			partial-update = <0x01>;
			status = "okay";
		};
	};

	fragment@32 {
		target = <0xffffffff>;

		__overlay__ {

			spc@40 {
				compatible = "prize,dcam_r";
				reg = <0x40>;
				pdn_pin = <0xffffffff 0x36 0x00>;
				rst_pin = <0xffffffff 0x4e 0x00>;
				sensor_type = <0x17f5>;
			};
		};
	};

	fragment@33 {
		target = <0xffffffff>;

		__overlay__ {

			adc_channel@ {
				compatible = "mediatek,adc_channel";
				mediatek,temperature0 = <0x00>;
				mediatek,temperature1 = <0x01>;
				mediatek,adc_fdd_rf_params_dynamic_custom_ch = <0x02>;
				mediatek,board_id = <0x03>;
				mediatek,board_id_2 = <0x04>;
				status = "okay";
			};
		};
	};

	fragment@34 {
		target = <0xffffffff>;

		__overlay__ {
			mediatek,clkbuf-quantity = <0x07>;
			mediatek,clkbuf-config = <0x02 0x01 0x01 0x02 0x00 0x00 0x01>;
			mediatek,clkbuf-driving-current = <0xffffffff 0xffffffff 0xffffffff 0xffffffff 0xffffffff 0xffffffff 0xffffffff>;
			status = "okay";
		};
	};

	fragment@35 {
		target = <0xffffffff>;

		__overlay__ {
			#address-cells = <0x01>;
			#size-cells = <0x00>;
			clock-frequency = <0x61a80>;
			mediatek,use-open-drain;

			cap_touch@5d {
				compatible = "mediatek,cap_touch";
				reg = <0x5d>;
				status = "okay";
				linux,phandle = <0x41>;
				phandle = <0x41>;
			};
		};
	};

	fragment@36 {
		target = <0xffffffff>;

		__overlay__ {
			#address-cells = <0x01>;
			#size-cells = <0x00>;
			clock-frequency = <0x61a80>;
			mediatek,use-open-drain;

			msensor@0c {
				compatible = "mediatek,msensor";
				reg = <0x0c>;
				status = "okay";
				linux,phandle = <0x42>;
				phandle = <0x42>;
			};

			gsensor@73 {
				compatible = "mediatek,gsensor";
				reg = <0x73>;
				status = "okay";
				linux,phandle = <0x43>;
				phandle = <0x43>;
			};

			alsps@67 {
				compatible = "mediatek,alsps";
				reg = <0x67>;
				status = "okay";
				interrupt-parent = <0xffffffff>;
				interrupts = <0x06 0x08 0x06 0x00>;
				linux,phandle = <0x44>;
				phandle = <0x44>;
			};

			barometer@77 {
				compatible = "mediatek,barometer";
				reg = <0x77>;
				status = "okay";
				linux,phandle = <0x45>;
				phandle = <0x45>;
			};

			speaker_amp@34 {
				compatible = "mediatek,speaker_amp";
				reg = <0x34>;
				status = "okay";
				linux,phandle = <0x46>;
				phandle = <0x46>;
			};

			ext_buck_lp4@57 {
				compatible = "mediatek,ext_buck_lp4";
				reg = <0x57>;
				status = "okay";
				linux,phandle = <0x47>;
				phandle = <0x47>;
			};

			ext_buck_lp4x@50 {
				compatible = "mediatek,ext_buck_lp4x";
				reg = <0x50>;
				status = "okay";
				linux,phandle = <0x48>;
				phandle = <0x48>;
			};

			gyro@72 {
				compatible = "mediatek,gyro";
				reg = <0x72>;
				status = "okay";
				linux,phandle = <0x49>;
				phandle = <0x49>;
			};

			icm426xx_gsensor@70 {
				compatible = "mediatek,icm426xx_gsensor";
				reg = <0x70>;
				status = "okay";
				linux,phandle = <0x4a>;
				phandle = <0x4a>;
			};

			icm426xx_gyro@71 {
				compatible = "mediatek,icm426xx_gyro";
				reg = <0x71>;
				status = "okay";
				linux,phandle = <0x4b>;
				phandle = <0x4b>;
			};
		};
	};

	fragment@37 {
		target = <0xffffffff>;

		__overlay__ {
			#address-cells = <0x01>;
			#size-cells = <0x00>;
			clock-frequency = <0x61a80>;
			mediatek,use-open-drain;

			camera_main@1a {
				compatible = "mediatek,camera_main";
				reg = <0x1a>;
				status = "okay";
				linux,phandle = <0x4c>;
				phandle = <0x4c>;
			};

			camera_main_af@0c {
				compatible = "mediatek,camera_main_af";
				reg = <0x0c>;
				status = "okay";
				linux,phandle = <0x4d>;
				phandle = <0x4d>;
			};

			camera_main_eeprom@1b {
				compatible = "mediatek,camera_main_eeprom";
				reg = <0x1b>;
				status = "okay";
				linux,phandle = <0x4e>;
				phandle = <0x4e>;
			};
		};
	};

	fragment@38 {
		target = <0xffffffff>;

		__overlay__ {
			#address-cells = <0x01>;
			#size-cells = <0x00>;
			clock-frequency = <0x61a80>;
			mediatek,use-open-drain;

			nfc@08 {
				compatible = "mediatek,nfc";
				reg = <0x08>;
				status = "okay";
				linux,phandle = <0x4f>;
				phandle = <0x4f>;
			};
		};
	};

	fragment@39 {
		target = <0xffffffff>;

		__overlay__ {
			#address-cells = <0x01>;
			#size-cells = <0x00>;
			clock-frequency = <0x61a80>;
			mediatek,use-open-drain;

			camera_sub@10 {
				compatible = "mediatek,camera_sub";
				reg = <0x10>;
				status = "okay";
				linux,phandle = <0x50>;
				phandle = <0x50>;
			};

			camera_sub_af@0c {
				compatible = "mediatek,camera_sub_af";
				reg = <0x0c>;
				status = "okay";
				linux,phandle = <0x51>;
				phandle = <0x51>;
			};

			camera_sub_eeprom@1c {
				compatible = "mediatek,camera_sub_eeprom";
				reg = <0x1c>;
				status = "okay";
				linux,phandle = <0x52>;
				phandle = <0x52>;
			};

			camera_main_two_eeprom@54 {
				compatible = "mediatek,camera_main_two_eeprom";
				reg = <0x54>;
				status = "okay";
				linux,phandle = <0x53>;
				phandle = <0x53>;
			};
		};
	};

	fragment@40 {
		target = <0xffffffff>;

		__overlay__ {
			#address-cells = <0x01>;
			#size-cells = <0x00>;
			clock-frequency = <0x33e140>;
			mediatek,use-push-pull;

			mt6370_pmu@34 {
				compatible = "mediatek,mt6370_pmu";
				reg = <0x34>;
				status = "okay";
				linux,phandle = <0x54>;
				phandle = <0x54>;
			};

			usb_type_c@4e {
				compatible = "mediatek,usb_type_c";
				reg = <0x4e>;
				status = "okay";
				linux,phandle = <0x55>;
				phandle = <0x55>;
			};
		};
	};

	fragment@41 {
		target = <0xffffffff>;

		__overlay__ {
			#address-cells = <0x01>;
			#size-cells = <0x00>;
			clock-frequency = <0x33e140>;
			mediatek,use-push-pull;

			vgpu_buck@6b {
				compatible = "mediatek,vgpu_buck";
				reg = <0x6b>;
				status = "okay";
				linux,phandle = <0x56>;
				phandle = <0x56>;
			};
		};
	};

	fragment@42 {
		target = <0xffffffff>;

		__overlay__ {
			#address-cells = <0x01>;
			#size-cells = <0x00>;
			clock-frequency = <0x61a80>;
			mediatek,use-open-drain;
		};
	};

	fragment@43 {
		target = <0xffffffff>;

		__overlay__ {
			#address-cells = <0x01>;
			#size-cells = <0x00>;
			clock-frequency = <0x61a80>;
			mediatek,use-open-drain;

			ccu_sensor_i2c_main_hw@33 {
				compatible = "mediatek,ccu_sensor_i2c_main_hw";
				reg = <0x33>;
				status = "okay";
				linux,phandle = <0x57>;
				phandle = <0x57>;
			};
		};
	};

	fragment@44 {
		target = <0xffffffff>;

		__overlay__ {
			#address-cells = <0x01>;
			#size-cells = <0x00>;
			clock-frequency = <0x61a80>;
			mediatek,use-open-drain;

			ccu_sensor_i2c_sub_hw@43 {
				compatible = "mediatek,ccu_sensor_i2c_sub_hw";
				reg = <0x43>;
				status = "okay";
				linux,phandle = <0x58>;
				phandle = <0x58>;
			};
		};
	};

	fragment@45 {
		target = <0xffffffff>;

		__overlay__ {
			GPIO_SIM2_SIO = <0xffffffff 0x23 0x00>;
			GPIO_SIM2_SRST = <0xffffffff 0x24 0x00>;
			GPIO_SIM2_SCLK = <0xffffffff 0x25 0x00>;
			GPIO_SIM1_SCLK = <0xffffffff 0x26 0x00>;
			GPIO_SIM1_SRST = <0xffffffff 0x27 0x00>;
			GPIO_SIM1_SIO = <0xffffffff 0x28 0x00>;
			GPIO_SIM1_HOT_PLUG = <0xffffffff 0x2f 0x00>;
		};
	};

	fragment@46 {
		target = <0xffffffff>;

		__overlay__ {
			gpio_init_default = <0x00 0x00 0x00 0x00 0x01 0x00 0x01 0x01 0x00 0x00 0x00 0x01 0x01 0x01 0x02 0x00 0x00 0x00 0x01 0x00 0x01 0x03 0x00 0x00 0x00 0x01 0x01 0x01 0x04 0x00 0x00 0x00 0x01 0x00 0x00 0x05 0x00 0x00 0x00 0x01 0x01 0x00 0x06 0x00 0x00 0x00 0x01 0x01 0x00 0x07 0x02 0x00 0x00 0x01 0x00 0x00 0x08 0x00 0x00 0x00 0x01 0x00 0x00 0x09 0x00 0x00 0x00 0x01 0x01 0x00 0x0a 0x00 0x01 0x00 0x00 0x00 0x00 0x0b 0x03 0x00 0x00 0x01 0x01 0x00 0x0c 0x03 0x00 0x00 0x01 0x01 0x00 0x0d 0x04 0x00 0x00 0x01 0x01 0x00 0x0e 0x00 0x01 0x00 0x00 0x00 0x00 0x0f 0x04 0x00 0x00 0x01 0x00 0x00 0x10 0x04 0x01 0x01 0x00 0x01 0x00 0x11 0x00 0x01 0x00 0x00 0x00 0x00 0x12 0x06 0x01 0x00 0x00 0x00 0x00 0x13 0x06 0x01 0x00 0x00 0x00 0x00 0x14 0x06 0x01 0x00 0x00 0x00 0x00 0x15 0x00 0x01 0x01 0x00 0x00 0x00 0x16 0x00 0x00 0x00 0x01 0x00 0x00 0x17 0x00 0x01 0x00 0x00 0x00 0x00 0x18 0x00 0x01 0x00 0x01 0x00 0x00 0x19 0x00 0x01 0x00 0x01 0x00 0x00 0x1a 0x00 0x01 0x00 0x00 0x00 0x00 0x1b 0x00 0x01 0x00 0x01 0x00 0x00 0x1c 0x00 0x00 0x00 0x01 0x01 0x00 0x1d 0x01 0x01 0x00 0x01 0x00 0x00 0x1e 0x01 0x00 0x00 0x01 0x01 0x00 0x1f 0x01 0x00 0x00 0x01 0x01 0x00 0x20 0x01 0x00 0x00 0x01 0x01 0x00 0x21 0x01 0x00 0x00 0x01 0x01 0x00 0x22 0x01 0x00 0x00 0x01 0x01 0x00 0x23 0x01 0x00 0x00 0x01 0x01 0x00 0x24 0x01 0x01 0x00 0x01 0x00 0x00 0x25 0x01 0x01 0x00 0x01 0x00 0x00 0x26 0x01 0x01 0x00 0x01 0x00 0x00 0x27 0x01 0x01 0x00 0x01 0x00 0x00 0x28 0x01 0x00 0x00 0x01 0x01 0x00 0x29 0x00 0x00 0x00 0x01 0x01 0x00 0x2a 0x01 0x01 0x00 0x01 0x00 0x00 0x2b 0x01 0x01 0x00 0x01 0x00 0x00 0x2c 0x01 0x00 0x00 0x01 0x00 0x00 0x2d 0x01 0x01 0x00 0x00 0x00 0x00 0x2e 0x00 0x00 0x00 0x01 0x00 0x00 0x2f 0x01 0x00 0x00 0x01 0x01 0x00 0x30 0x01 0x00 0x00 0x01 0x01 0x00 0x31 0x01 0x00 0x00 0x01 0x01 0x00 0x32 0x01 0x00 0x00 0x01 0x01 0x00 0x33 0x01 0x00 0x00 0x01 0x01 0x00 0x34 0x01 0x01 0x00 0x01 0x00 0x00 0x35 0x01 0x01 0x00 0x01 0x00 0x00 0x36 0x01 0x01 0x00 0x01 0x00 0x00 0x37 0x01 0x01 0x00 0x01 0x00 0x00 0x38 0x01 0x01 0x00 0x01 0x00 0x00 0x39 0x01 0x01 0x00 0x01 0x00 0x00 0x3a 0x01 0x01 0x00 0x00 0x00 0x00 0x3b 0x01 0x01 0x00 0x01 0x00 0x00 0x3c 0x01 0x01 0x00 0x01 0x00 0x00 0x3d 0x01 0x00 0x00 0x01 0x00 0x00 0x3e 0x01 0x00 0x00 0x01 0x00 0x00 0x3f 0x01 0x00 0x00 0x01 0x00 0x00 0x40 0x01 0x00 0x00 0x01 0x00 0x00 0x41 0x02 0x00 0x00 0x01 0x00 0x00 0x42 0x02 0x00 0x00 0x01 0x00 0x00 0x43 0x01 0x00 0x00 0x01 0x00 0x00 0x44 0x01 0x00 0x00 0x01 0x00 0x00 0x45 0x01 0x01 0x00 0x01 0x00 0x00 0x46 0x01 0x01 0x00 0x01 0x00 0x00 0x47 0x01 0x00 0x00 0x01 0x00 0x00 0x48 0x01 0x00 0x00 0x01 0x00 0x00 0x49 0x01 0x01 0x00 0x01 0x00 0x00 0x4a 0x01 0x01 0x00 0x01 0x00 0x00 0x4b 0x01 0x01 0x00 0x01 0x00 0x00 0x4c 0x01 0x01 0x00 0x01 0x00 0x00 0x4d 0x01 0x01 0x00 0x01 0x00 0x00 0x4e 0x01 0x01 0x00 0x01 0x00 0x00 0x4f 0x01 0x01 0x00 0x01 0x00 0x00 0x50 0x00 0x01 0x00 0x01 0x00 0x00 0x51 0x01 0x00 0x00 0x01 0x01 0x00 0x52 0x01 0x00 0x00 0x01 0x01 0x00 0x53 0x01 0x00 0x00 0x01 0x01 0x00 0x54 0x01 0x00 0x00 0x01 0x01 0x00 0x55 0x01 0x01 0x00 0x01 0x00 0x00 0x56 0x01 0x00 0x00 0x01 0x00 0x00 0x57 0x01 0x00 0x00 0x01 0x00 0x00 0x58 0x01 0x01 0x00 0x01 0x00 0x00 0x59 0x01 0x00 0x00 0x01 0x00 0x00 0x5a 0x00 0x01 0x00 0x00 0x00 0x00 0x5b 0x00 0x00 0x00 0x01 0x01 0x00 0x5c 0x01 0x01 0x00 0x00 0x00 0x00 0x5d 0x01 0x00 0x00 0x01 0x01 0x00 0x5e 0x01 0x00 0x00 0x01 0x01 0x00 0x5f 0x01 0x00 0x00 0x01 0x01 0x00 0x60 0x01 0x01 0x01 0x00 0x00 0x00 0x61 0x00 0x01 0x00 0x00 0x00 0x00 0x62 0x00 0x01 0x00 0x00 0x00 0x00 0x63 0x01 0x01 0x00 0x00 0x00 0x00 0x64 0x01 0x01 0x00 0x00 0x00 0x00 0x65 0x00 0x01 0x00 0x00 0x00 0x00 0x66 0x00 0x01 0x00 0x00 0x00 0x00 0x67 0x01 0x00 0x00 0x01 0x01 0x00 0x68 0x01 0x00 0x00 0x01 0x01 0x00 0x69 0x01 0x00 0x00 0x01 0x01 0x00 0x6a 0x01 0x00 0x00 0x01 0x01 0x00 0x6b 0x00 0x01 0x00 0x00 0x00 0x00 0x6c 0x00 0x01 0x01 0x00 0x00 0x00 0x6d 0x00 0x01 0x00 0x00 0x00 0x00 0x6e 0x01 0x00 0x00 0x01 0x00 0x00 0x6f 0x01 0x00 0x00 0x01 0x00 0x00 0x70 0x01 0x00 0x01 0x01 0x00 0x00 0x71 0x01 0x00 0x00 0x01 0x00 0x00 0x72 0x01 0x00 0x00 0x01 0x00 0x00 0x73 0x01 0x00 0x00 0x01 0x00 0x00 0x74 0x01 0x00 0x00 0x01 0x00 0x00 0x75 0x01 0x00 0x00 0x01 0x00 0x00 0x76 0x01 0x00 0x00 0x01 0x00 0x00 0x77 0x01 0x00 0x00 0x01 0x00 0x00 0x78 0x01 0x00 0x00 0x01 0x00 0x00 0x79 0x01 0x00 0x00 0x01 0x00 0x00 0x7a 0x00 0x00 0x00 0x01 0x00 0x00 0x7b 0x00 0x00 0x00 0x01 0x00 0x00 0x7c 0x00 0x00 0x00 0x01 0x00 0x00 0x7d 0x00 0x00 0x00 0x01 0x00 0x00 0x7e 0x00 0x00 0x00 0x01 0x00 0x00 0x7f 0x00 0x00 0x00 0x01 0x00 0x00 0x80 0x00 0x00 0x00 0x01 0x00 0x00 0x81 0x00 0x00 0x00 0x01 0x00 0x00 0x82 0x00 0x00 0x00 0x01 0x00 0x00 0x83 0x00 0x01 0x00 0x00 0x00 0x00 0x84 0x00 0x00 0x00 0x01 0x00 0x00 0x85 0x00 0x00 0x00 0x01 0x00 0x00 0x86 0x01 0x00 0x00 0x00 0x00 0x01 0x87 0x01 0x01 0x00 0x00 0x00 0x00 0x88 0x01 0x00 0x00 0x00 0x00 0x00 0x89 0x01 0x00 0x00 0x00 0x00 0x00 0x8a 0x01 0x00 0x00 0x00 0x00 0x00 0x8b 0x01 0x00 0x00 0x00 0x00 0x00 0x8c 0x01 0x00 0x00 0x00 0x00 0x00 0x8d 0x01 0x00 0x00 0x00 0x00 0x00 0x8e 0x01 0x00 0x00 0x00 0x00 0x00 0x8f 0x01 0x00 0x00 0x00 0x00 0x00 0x90 0x01 0x00 0x00 0x00 0x00 0x00 0x91 0x01 0x01 0x01 0x00 0x00 0x00 0x92 0x01 0x00 0x00 0x00 0x00 0x00 0x93 0x01 0x00 0x00 0x00 0x00 0x00 0x94 0x01 0x01 0x01 0x00 0x00 0x00 0x95 0x01 0x01 0x00 0x00 0x00 0x00 0x96 0x01 0x01 0x00 0x01 0x00 0x00 0x97 0x01 0x01 0x00 0x01 0x00 0x00 0x98 0x00 0x00 0x00 0x01 0x00 0x00 0x99 0x00 0x00 0x00 0x01 0x00 0x00 0x9a 0x00 0x00 0x00 0x01 0x00 0x00 0x9b 0x00 0x00 0x00 0x01 0x00 0x00 0x9c 0x00 0x00 0x00 0x01 0x00 0x00 0x9d 0x00 0x00 0x00 0x01 0x00 0x00 0x9e 0x00 0x00 0x00 0x01 0x00 0x00 0x9f 0x00 0x00 0x00 0x01 0x00 0x00 0xa0 0x00 0x00 0x00 0x01 0x00 0x00 0xa1 0x00 0x00 0x00 0x01 0x00 0x00 0xa2 0x00 0x00 0x00 0x01 0x00 0x00 0xa3 0x00 0x00 0x00 0x01 0x00 0x00>;
		};
	};

	fragment@47 {
		target = <0xffffffff>;

		__overlay__ {
			interrupt-parent = <0xffffffff>;
			interrupts = <0x00 0x04 0x00 0x00>;
			status = "okay";
		};
	};

	fragment@48 {
		target = <0xffffffff>;

		__overlay__ {
			interrupt-parent = <0xffffffff>;
			interrupts = <0x01 0x02 0x01 0x00>;
			status = "okay";
		};
	};

	fragment@49 {
		target = <0xffffffff>;

		__overlay__ {
			interrupt-parent = <0xffffffff>;
			interrupts = <0x02 0x04 0x02 0x00>;
			status = "okay";
		};
	};

	fragment@50 {
		target = <0xffffffff>;

		__overlay__ {
			interrupt-parent = <0xffffffff>;
			interrupts = <0x03 0x08 0x03 0x00>;
			status = "okay";
		};
	};

	fragment@51 {
		target = <0xffffffff>;

		__overlay__ {
			interrupt-parent = <0xffffffff>;
			interrupts = <0x04 0x08 0x04 0x00>;
			status = "okay";
		};
	};

	fragment@52 {
		target = <0xffffffff>;

		__overlay__ {
			interrupt-parent = <0xffffffff>;
			interrupts = <0x05 0x08 0x05 0x00>;
			status = "okay";
		};
	};

	fragment@53 {
		target = <0xffffffff>;

		__overlay__ {
			interrupt-parent = <0xffffffff>;
			interrupts = <0x09 0x08 0x09 0x00>;
			deb-gpios = <0xffffffff 0x09 0x00>;
			debounce = <0x3e800>;
			status = "okay";
		};
	};

	fragment@54 {
		target = <0xffffffff>;

		__overlay__ {
			interrupt-parent = <0xffffffff>;
			interrupts = <0x29 0x02 0x29 0x00>;
			status = "okay";
		};
	};

	fragment@55 {
		target = <0xffffffff>;

		__overlay__ {
			interrupt-parent = <0xffffffff>;
			interrupts = <0x2c 0x01 0x2c 0x01>;
			status = "okay";
		};
	};

	fragment@56 {
		target = <0xffffffff>;

		__overlay__ {
			interrupt-parent = <0xffffffff>;
			interrupts = <0x5b 0x08 0x5b 0x00>;
			status = "okay";
		};
	};

	fragment@57 {
		target = <0xffffffff>;

		__overlay__ {
			interrupt-parent = <0xffffffff>;
			interrupts = <0x96 0x04 0xa2 0x00>;
			status = "okay";
		};
	};

	fragment@58 {
		target = <0xffffffff>;

		__overlay__ {

			MD1_SIM1_HOT_PLUG_EINT@0 {
				compatible = "mediatek,MD1_SIM1_HOT_PLUG_EINT-eint";
				interrupts = <0x00 0x08>;
				debounce = <0x00 0x186a0>;
				dedicated = <0x00 0x00>;
				src_pin = <0x00 0x01>;
				sockettype = <0x00 0x00>;
				status = "okay";
			};
		};
	};

	fragment@59 {
		target = <0xffffffff>;

		__overlay__ {
			regulator-name = "vcama";
			regulator-default-on = <0x01>;
			status = "okay";
		};
	};

	fragment@60 {
		target = <0xffffffff>;

		__overlay__ {
			regulator-name = "vsim1";
			regulator-default-on = <0x01>;
			status = "okay";
		};
	};

	fragment@61 {
		target = <0xffffffff>;

		__overlay__ {
			regulator-name = "vsim2";
			regulator-default-on = <0x01>;
			status = "okay";
		};
	};

	fragment@62 {
		target = <0xffffffff>;

		__overlay__ {
			regulator-name = "vcamd";
			regulator-default-on = <0x01>;
			status = "okay";
		};
	};

	fragment@63 {
		target = <0xffffffff>;

		__overlay__ {
			regulator-name = "vcamio";
			regulator-default-on = <0x01>;
			status = "okay";
		};
	};

	fragment@64 {
		target = <0xffffffff>;

		__overlay__ {
			regulator-name = "vldo28";
			regulator-default-on = <0x01>;
			status = "okay";
		};
	};

	fragment@65 {
		target = <0xffffffff>;

		__overlay__ {
			vcama-supply = <0xffffffff>;
			vcama_main2-supply = <0xffffffff>;
			vcama_sub-supply = <0xffffffff>;
			vcamd-supply = <0xffffffff>;
			vcamd_main2-supply = <0xffffffff>;
			vcamd_sub-supply = <0xffffffff>;
			vcamio-supply = <0xffffffff>;
			vcamio_main2-supply = <0xffffffff>;
			vcamio_sub-supply = <0xffffffff>;
			vcamaf-supply = <0xffffffff>;
			status = "okay";
		};
	};

	fragment@66 {
		target = <0xffffffff>;

		__overlay__ {
			vtouch-supply = <0xffffffff>;
			status = "okay";
		};
	};

	fragment@67 {
		target = <0xffffffff>;

		__overlay__ {
			mediatek,kpd-key-debounce = <0x400>;
			mediatek,kpd-sw-pwrkey = <0x74>;
			mediatek,kpd-hw-pwrkey = <0x08>;
			mediatek,kpd-sw-rstkey = <0x73>;
			mediatek,kpd-hw-rstkey = <0x11>;
			mediatek,kpd-use-extend-type = <0x00>;
			mediatek,kpd-hw-map-num = <0x48>;
			mediatek,kpd-hw-init-map = <0x72 0x00 0x00 0x00 0x00 0x00 0x00 0x00 0x00 0x00 0x00 0x00 0x00 0x00 0x00 0x00 0x00 0x00 0x00 0x00 0x00 0x00 0x00 0x00 0x00 0x00 0x00 0x00 0x00 0x00 0x00 0x00 0x00 0x00 0x00 0x00 0x00 0x00 0x00 0x00 0x00 0x00 0x00 0x00 0x00 0x00 0x00 0x00 0x00 0x00 0x00 0x00 0x00 0x00 0x00 0x00 0x00 0x00 0x00 0x00 0x00 0x00 0x00 0x00 0x00 0x00 0x00 0x00 0x00 0x00 0x00 0x00>;
			mediatek,kpd-pwrkey-eint-gpio = <0x00>;
			mediatek,kpd-pwkey-gpio-din = <0x00>;
			mediatek,kpd-hw-dl-key0 = <0x11>;
			mediatek,kpd-hw-dl-key1 = <0x00>;
			mediatek,kpd-hw-dl-key2 = <0x08>;
			mediatek,kpd-hw-recovery-key = <0x11>;
			mediatek,kpd-hw-factory-key = <0x00>;
			status = "okay";
		};
	};

	__symbols__ {
		led0 = "/fragment@2/__overlay__/led@0";
		led1 = "/fragment@2/__overlay__/led@1";
		led2 = "/fragment@2/__overlay__/led@2";
		led3 = "/fragment@2/__overlay__/led@3";
		led4 = "/fragment@2/__overlay__/led@4";
		led5 = "/fragment@2/__overlay__/led@5";
		led6 = "/fragment@2/__overlay__/led@6";
		vibrator0 = "/fragment@2/__overlay__/vibrator@0";
		ctp_pins_default = "/fragment@8/__overlay__/eint0default";
		ctp_pins_eint_as_int = "/fragment@8/__overlay__/eint@0";
		ctp_pins_eint_output0 = "/fragment@8/__overlay__/eintoutput0";
		ctp_pins_eint_output1 = "/fragment@8/__overlay__/eintoutput1";
		ctp_pins_rst_output0 = "/fragment@8/__overlay__/rstoutput0";
		ctp_pins_rst_output1 = "/fragment@8/__overlay__/rstoutput1";
		alsps_intpin_cfg = "/fragment@11/__overlay__/alspspincfg";
		alsps_intpin_default = "/fragment@11/__overlay__/alspsdefaultcfg";
		accdet_pins_default = "/fragment@13/__overlay__/accdetdefault";
		accdet_pins_eint_as_int = "/fragment@13/__overlay__/accdeteint@0";
		consys_pins_default = "/fragment@14/__overlay__/consys_default";
		gpslna_pins_init = "/fragment@14/__overlay__/gpslna@0";
		gpslna_pins_oh = "/fragment@14/__overlay__/gpslna@1";
		gpslna_pins_ol = "/fragment@14/__overlay__/gpslna@2";
		camera_pins_cam0_rst0 = "/fragment@16/__overlay__/cam0@0";
		camera_pins_cam0_rst1 = "/fragment@16/__overlay__/cam0@1";
		camera_pins_cam0_pnd0 = "/fragment@16/__overlay__/cam0@2";
		camera_pins_cam0_pnd1 = "/fragment@16/__overlay__/cam0@3";
		camera_pins_cam1_rst0 = "/fragment@16/__overlay__/cam1@0";
		camera_pins_cam1_rst1 = "/fragment@16/__overlay__/cam1@1";
		camera_pins_cam1_pnd0 = "/fragment@16/__overlay__/cam1@2";
		camera_pins_cam1_pnd1 = "/fragment@16/__overlay__/cam1@3";
		camera_pins_cam0_mclk_on = "/fragment@16/__overlay__/camera_pins_cam0_mclk_on";
		camera_pins_cam0_mclk_off = "/fragment@16/__overlay__/camera_pins_cam0_mclk_off";
		camera_pins_cam1_mclk_on = "/fragment@16/__overlay__/camera_pins_cam1_mclk_on";
		camera_pins_cam1_mclk_off = "/fragment@16/__overlay__/camera_pins_cam1_mclk_off";
		camera_pins_default = "/fragment@16/__overlay__/camdefault";
		fingerprint = "/fragment@18/__overlay__/fingerprint@spi0";
		fpc_pins_default = "/fragment@20/__overlay__/fpcdefault";
		fpc_pins_eint_as_int = "/fragment@20/__overlay__/fpceint@0";
		fpc_pins_rst_high = "/fragment@20/__overlay__/fpcrsthigh";
		fpc_pins_rst_low = "/fragment@20/__overlay__/fpcrstlow";
		fpc_pins_pwr_high = "/fragment@20/__overlay__/fpcpwrhigh";
		fpc_pins_pwr_low = "/fragment@20/__overlay__/fpcpwrlow";
		fpc_mode_as_cs = "/fragment@20/__overlay__/fpccs";
		fpc_mode_as_ck = "/fragment@20/__overlay__/fpcck";
		fpc_mode_as_mi = "/fragment@20/__overlay__/fpcmi";
		fpc_mode_as_mo = "/fragment@20/__overlay__/fpcmo";
		fpc_miso_pull_up = "/fragment@20/__overlay__/fpcmisoup";
		fpc_miso_pull_down = "/fragment@20/__overlay__/fpcmisolow";
		fpc_mosi_pull_up = "/fragment@20/__overlay__/fpcmosiup";
		fpc_mosi_pull_down = "/fragment@20/__overlay__/fpcmosilow";
		uart0_gpio_def_cfg = "/fragment@23/__overlay__/uart0gpiodefault";
		uart0_rx_set_cfg = "/fragment@23/__overlay__/uart0_rx_set@gpio95";
		uart0_rx_clr_cfg = "/fragment@23/__overlay__/uart0_rx_clear@gpio95";
		uart0_tx_set_cfg = "/fragment@23/__overlay__/uart0_tx_set@gpio96";
		uart0_tx_clr_cfg = "/fragment@23/__overlay__/uart0_tx_clear@gpio96";
		uart1_gpio_def_cfg = "/fragment@23/__overlay__/uart1gpiodefault";
		irtx_gpio_led_default = "/fragment@25/__overlay__/irtx_gpio_led_def@gpio58";
		irtx_gpio_led_set = "/fragment@25/__overlay__/irtx_gpio_led_set@gpio58";
		aud_dat_mosi_off = "/fragment@27/__overlay__/aud_dat_mosi_off";
		aud_dat_mosi_on = "/fragment@27/__overlay__/aud_dat_mosi_on";
		aud_dat_miso_off = "/fragment@27/__overlay__/aud_dat_miso_off";
		aud_dat_miso_on = "/fragment@27/__overlay__/aud_dat_miso_on";
		aud_pins_extamp_pullhigh = "/fragment@27/__overlay__/aud_pins_extamp_pullhigh";
		aud_pins_extamp_pulllow = "/fragment@27/__overlay__/aud_pins_extamp_pulllow";
		cap_touch_mtk = "/fragment@35/__overlay__/cap_touch@5d";
		msensor_mtk = "/fragment@36/__overlay__/msensor@0c";
		gsensor_mtk = "/fragment@36/__overlay__/gsensor@73";
		alsps_mtk = "/fragment@36/__overlay__/alsps@67";
		barometer_mtk = "/fragment@36/__overlay__/barometer@77";
		speaker_amp_mtk = "/fragment@36/__overlay__/speaker_amp@34";
		ext_buck_lp4_mtk = "/fragment@36/__overlay__/ext_buck_lp4@57";
		ext_buck_lp4x_mtk = "/fragment@36/__overlay__/ext_buck_lp4x@50";
		gyro_mtk = "/fragment@36/__overlay__/gyro@72";
		icm426xx_gsensor_mtk = "/fragment@36/__overlay__/icm426xx_gsensor@70";
		icm426xx_gyro_mtk = "/fragment@36/__overlay__/icm426xx_gyro@71";
		camera_main_mtk = "/fragment@37/__overlay__/camera_main@1a";
		camera_main_af_mtk = "/fragment@37/__overlay__/camera_main_af@0c";
		camera_main_eeprom_mtk = "/fragment@37/__overlay__/camera_main_eeprom@1b";
		nfc_mtk = "/fragment@38/__overlay__/nfc@08";
		camera_sub_mtk = "/fragment@39/__overlay__/camera_sub@10";
		camera_sub_af_mtk = "/fragment@39/__overlay__/camera_sub_af@0c";
		camera_sub_eeprom_mtk = "/fragment@39/__overlay__/camera_sub_eeprom@1c";
		camera_main_two_eeprom_mtk = "/fragment@39/__overlay__/camera_main_two_eeprom@54";
		mt6370_pmu_mtk = "/fragment@40/__overlay__/mt6370_pmu@34";
		usb_type_c_mtk = "/fragment@40/__overlay__/usb_type_c@4e";
		vgpu_buck_mtk = "/fragment@41/__overlay__/vgpu_buck@6b";
		ccu_sensor_i2c_main_hw_mtk = "/fragment@43/__overlay__/ccu_sensor_i2c_main_hw@33";
		ccu_sensor_i2c_sub_hw_mtk = "/fragment@44/__overlay__/ccu_sensor_i2c_sub_hw@43";
	};

	__fixups__ {
		reserved_memory = "/fragment@0:target:0";
		chosen = "/fragment@1:target:0";
		odm = "/fragment@2:target:0";
		i2c0 = "/fragment@3:target:0\0/fragment@35:target:0";
		i2c1 = "/fragment@4:target:0\0/fragment@36:target:0";
		msdc0 = "/fragment@5:target:0";
		i2c8 = "/fragment@6:target:0\0/fragment@43:target:0";
		touch = "/fragment@7:target:0\0/fragment@48:target:0\0/fragment@66:target:0";
		pio = "/fragment@8:target:0\0/fragment@11:target:0\0/fragment@13:target:0\0/fragment@14:target:0\0/fragment@16:target:0\0/fragment@18/__overlay__/fingerprint@spi0:fingerprint,touch-int-gpio:0\0/fragment@19/__overlay__:interrupt-parent:0\0/fragment@20:target:0\0/fragment@23:target:0\0/fragment@25:target:0\0/fragment@27:target:0\0/fragment@28/__overlay__:mt6370,intr_gpio:0\0/fragment@29/__overlay__:mt6370pd,intr_gpio:0\0/fragment@30/__overlay__:gpio-rst-std:0\0/fragment@30/__overlay__:gpio-irq-std:0\0/fragment@32/__overlay__/spc@40:pdn_pin:0\0/fragment@32/__overlay__/spc@40:rst_pin:0\0/fragment@36/__overlay__/alsps@67:interrupt-parent:0\0/fragment@45/__overlay__:GPIO_SIM2_SIO:0\0/fragment@45/__overlay__:GPIO_SIM2_SRST:0\0/fragment@45/__overlay__:GPIO_SIM2_SCLK:0\0/fragment@45/__overlay__:GPIO_SIM1_SCLK:0\0/fragment@45/__overlay__:GPIO_SIM1_SRST:0\0/fragment@45/__overlay__:GPIO_SIM1_SIO:0\0/fragment@45/__overlay__:GPIO_SIM1_HOT_PLUG:0\0/fragment@47/__overlay__:interrupt-parent:0\0/fragment@48/__overlay__:interrupt-parent:0\0/fragment@49/__overlay__:interrupt-parent:0\0/fragment@50/__overlay__:interrupt-parent:0\0/fragment@51/__overlay__:interrupt-parent:0\0/fragment@52/__overlay__:interrupt-parent:0\0/fragment@53/__overlay__:interrupt-parent:0\0/fragment@53/__overlay__:deb-gpios:0\0/fragment@54/__overlay__:interrupt-parent:0\0/fragment@55/__overlay__:interrupt-parent:0\0/fragment@56/__overlay__:interrupt-parent:0\0/fragment@57/__overlay__:interrupt-parent:0";
		g_sensor = "/fragment@9:target:0";
		m_sensor = "/fragment@10:target:0";
		accdet = "/fragment@12:target:0\0/fragment@53:target:0";
		consys = "/fragment@15:target:0";
		kd_camera_hw1 = "/fragment@17:target:0\0/fragment@65:target:0";
		spi0 = "/fragment@18:target:0";
		fpc = "/fragment@19:target:0";
		apuart0 = "/fragment@21:target:0";
		apuart1 = "/fragment@22:target:0";
		irtx_pwm = "/fragment@24:target:0";
		audgpio = "/fragment@26:target:0";
		mt6370_pmu = "/fragment@28:target:0";
		mt6370_typec = "/fragment@29:target:0";
		nfc = "/fragment@30:target:0";
		mtkfb = "/fragment@31:target:0";
		i2c4 = "/fragment@32:target:0\0/fragment@39:target:0";
		auxadc = "/fragment@33:target:0";
		pmic_clock_buffer_ctrl = "/fragment@34:target:0";
		i2c2 = "/fragment@37:target:0";
		i2c3 = "/fragment@38:target:0";
		i2c5 = "/fragment@40:target:0";
		i2c6 = "/fragment@41:target:0";
		i2c7 = "/fragment@42:target:0";
		i2c9 = "/fragment@44:target:0";
		gpio_usage_mapping = "/fragment@45:target:0";
		gpio = "/fragment@46:target:0";
		irq_nfc = "/fragment@47:target:0";
		smart_pa = "/fragment@49:target:0";
		msdc1_ins = "/fragment@50:target:0";
		gyro = "/fragment@51:target:0";
		rt9465_slave_chr = "/fragment@52:target:0";
		mt6370_pd = "/fragment@54:target:0";
		dsi_te = "/fragment@55:target:0";
		mt6370_pmu_eint = "/fragment@56:target:0";
		main_pmic = "/fragment@57:target:0";
		eintc = "/fragment@58:target:0";
		mt_pmic_vcama_ldo_reg = "/fragment@59:target:0\0/fragment@65/__overlay__:vcama-supply:0\0/fragment@65/__overlay__:vcama_main2-supply:0\0/fragment@65/__overlay__:vcama_sub-supply:0";
		mt_pmic_vsim1_ldo_reg = "/fragment@60:target:0";
		mt_pmic_vsim2_ldo_reg = "/fragment@61:target:0";
		mt_pmic_vcamd_ldo_reg = "/fragment@62:target:0\0/fragment@65/__overlay__:vcamd-supply:0\0/fragment@65/__overlay__:vcamd_main2-supply:0\0/fragment@65/__overlay__:vcamd_sub-supply:0";
		mt_pmic_vcamio_ldo_reg = "/fragment@63:target:0\0/fragment@65/__overlay__:vcamio-supply:0\0/fragment@65/__overlay__:vcamio_main2-supply:0\0/fragment@65/__overlay__:vcamio_sub-supply:0";
		mt_pmic_vldo28_ldo_reg = "/fragment@64:target:0\0/fragment@65/__overlay__:vcamaf-supply:0\0/fragment@66/__overlay__:vtouch-supply:0";
		keypad = "/fragment@67:target:0";
	};

	__local_fixups__ {

		fragment@4 {

			__overlay__ {

				alsps@67 {
					pinctrl-0 = <0x00>;
					pinctrl-1 = <0x00>;
				};
			};
		};

		fragment@7 {

			__overlay__ {
				pinctrl-0 = <0x00>;
				pinctrl-1 = <0x00>;
				pinctrl-2 = <0x00>;
				pinctrl-3 = <0x00>;
				pinctrl-4 = <0x00>;
				pinctrl-5 = <0x00>;
			};
		};

		fragment@12 {

			__overlay__ {
				pinctrl-0 = <0x00>;
				pinctrl-1 = <0x00>;
			};
		};

		fragment@15 {

			__overlay__ {
				pinctrl-0 = <0x00>;
				pinctrl-1 = <0x00>;
				pinctrl-2 = <0x00>;
				pinctrl-3 = <0x00>;
			};
		};

		fragment@17 {

			__overlay__ {
				pinctrl-0 = <0x00>;
				pinctrl-1 = <0x00>;
				pinctrl-2 = <0x00>;
				pinctrl-3 = <0x00>;
				pinctrl-4 = <0x00>;
				pinctrl-5 = <0x00>;
				pinctrl-6 = <0x00>;
				pinctrl-7 = <0x00>;
				pinctrl-8 = <0x00>;
				pinctrl-13 = <0x00>;
				pinctrl-14 = <0x00>;
				pinctrl-15 = <0x00>;
				pinctrl-16 = <0x00>;
			};
		};

		fragment@19 {

			__overlay__ {
				pinctrl-0 = <0x00>;
				pinctrl-1 = <0x00>;
				pinctrl-2 = <0x00>;
				pinctrl-3 = <0x00>;
				pinctrl-4 = <0x00>;
				pinctrl-5 = <0x00>;
				pinctrl-6 = <0x00>;
				pinctrl-7 = <0x00>;
				pinctrl-8 = <0x00>;
				pinctrl-9 = <0x00>;
				pinctrl-10 = <0x00>;
				pinctrl-11 = <0x00>;
				pinctrl-12 = <0x00>;
				pinctrl-13 = <0x00>;
			};
		};

		fragment@21 {

			__overlay__ {
				pinctrl-0 = <0x00>;
				pinctrl-1 = <0x00>;
				pinctrl-2 = <0x00>;
				pinctrl-3 = <0x00>;
				pinctrl-4 = <0x00>;
			};
		};

		fragment@22 {

			__overlay__ {
				pinctrl-0 = <0x00>;
			};
		};

		fragment@24 {

			__overlay__ {
				pinctrl-0 = <0x00>;
				pinctrl-1 = <0x00>;
			};
		};

		fragment@26 {

			__overlay__ {
				pinctrl-0 = <0x00>;
				pinctrl-1 = <0x00>;
				pinctrl-2 = <0x00>;
				pinctrl-3 = <0x00>;
				pinctrl-4 = <0x00>;
				pinctrl-5 = <0x00>;
			};
		};
	};
};
